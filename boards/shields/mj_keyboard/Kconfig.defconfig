## boards/shields/mj_keyboard/Kconfig.defconfig
```kconfig
if SHIELD_SPLIT_ERGO_TB_LEFT

config ZMK_POINTING
    default y

config PAW3222
    default y

config ZMK_KEYBOARD_NAME
    default "split_ergo_tb"

endif

if SHIELD_SPLIT_ERGO_TB_LEFT || SHIELD_SPLIT_ERGO_TB_RIGHT

config ZMK_SPLIT
    default y

endif
```

## boards/shields/mj_keyboard/Kconfig.shield
```kconfig
config SHIELD_SPLIT_ERGO_TB_LEFT
    def_bool $(shields_list_contains,split_ergo_tb_left)
config SHIELD_SPLIT_ERGO_TB_RIGHT
    def_bool $(shields_list_contains,split_ergo_tb_right)
```

## config/west.yml
```yaml
manifest:
  remotes:
    - name: zmkfirmware
      url-base: https://github.com/zmkfirmware
    - name: sekigon-gonnoc
      url-base: https://github.com/sekigon-gonnoc
    - name: pointing-acceleration
      url-base: https://github.com/rain-bbb
    - name: yamaryu211
      url-base: https://github.com/yamaryu211
  projects:
    - name: zmk-pointing-acceleration
      remote: pointing-acceleration
      revision: main
    - name: zmk
      remote: zmkfirmware
      revision: v0.3
      import: app/west.yml
    - name: zmk-driver-paw3222
      remote: sekigon-gonnoc
      revision: main
    - name: zmk-input-processor-temp-layer-threshold
      remote: yamaryu211
      revision: main
  self:
    path: config
```
